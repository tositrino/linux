## ADDONS/CHANGES/drivers/media/video/ov51x/Kconfig
```kconfig
config VIDEO_OV51X
	tristate "OV51X/Eyetoy sensor support"
	depends on VIDEO_V4L2
	---help---
	  This is a Video4Linux2 sensor-level driver for ov51x / eyetoy 
	  camera
```

## ADDONS/CONFIGS/3.0/WORK/dohofpga2/ths/drivers/media/video/dohofpga/Kconfig
```kconfig
#
# Kconfig for dohofpga driver modules
#

config VIDEO_DOHOFPGA1
  tristate "dohofpga version 1 support"
  depends on I2C
  help
    This driver supports Dominik Honeggers FPGA camera interface
choice
  depends on VIDEO_DOHOFPGA1
  prompt "Select ITU/MIPI Camera port for DOHOFPGA1"
  default DOHOFPGA1_ITU_A
  config DOHOFPGA1_ITU_A
    bool "ITU Camera A port"
    depends on I2C
    help
      This enables support for ITU A port
  config DOHOFPGA1_ITU_B
    bool "ITU Camera B port"
    depends on I2C
    help
      This enables support for ITU B port
  config DOHOFPGA1_CSI_C
    bool "CSI Camera A port"
    depends on (VIDEO_FIMC_MIPI || VIDEO_S5P_MIPI_CSIS)
    help
      This enables support for CSI A port
  config DOHOFPGA1_CSI_D
    bool "CSI Camera B port"
    depends on (VIDEO_FIMC_MIPI || VIDEO_S5P_MIPI_CSIS)
    help
      This enables support for CSI B port
endchoice

config VIDEO_DOHOFPGA2
  tristate "dohofpga version 2 support"
  depends on I2C
  help
    This driver supports Dominik Honeggers FPGA camera interface
choice
  depends on VIDEO_DOHOFPGA2
  prompt "Select ITU/MIPI Camera port for DOHOFPGA2"
  default DOHOFPGA2_ITU_A
  config DOHOFPGA2_ITU_A
    bool "ITU Camera A port"
    depends on I2C
    help
      This enables support for ITU A port
  config DOHOFPGA2_ITU_B
    bool "ITU Camera B port"
    depends on I2C
    help
      This enables support for ITU B port
  config DOHOFPGA2_CSI_C
    bool "CSI Camera A port"
    depends on (VIDEO_FIMC_MIPI || VIDEO_S5P_MIPI_CSIS)
    help
      This enables support for CSI A port
  config DOHOFPGA2_CSI_D
    bool "CSI Camera B port"
    depends on (VIDEO_FIMC_MIPI || VIDEO_S5P_MIPI_CSIS)
    help
      This enables support for CSI B port
endchoice
```

## WORK/linux-ths/drivers/misc/hdrv/Kconfig
```kconfig
config  HDRV_DEV
	tristate "Hello Device (testing driver)"
	default n
	help
	  The Hello Device Driver (HDRV) is a driver testing framework. it creates
	  a device file called /dev/HDRV_DEV_NAME (defaults to /dev/hello) which will 
	  return the string defined under HELLO_DEV_MESSAGE (defaults to "Hello World") 
	  when it is read.

config HDRV_DEV_MESSAGE
	string "Hello Device Driver output message"
    default "Hello World"
	depends on HDRV_DEV
	help
	  define the string that will be returned by reading the device file
	  /dev/HDRV_DEV_NAME (default "Hello World" )

config HDRV_DEV_NAME
	string "Hello Device Driver device name"
	default "hello"
	depends on HDRV_DEV
	help
	  define the device file name (default "hello")
```
